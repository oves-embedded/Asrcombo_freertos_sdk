/*
 * Copyright (c) 2022 ASR Microelectronics (Shanghai) Co., Ltd. All rights reserved.
 * Licensed under the Apache License, Version 2.0 (the "License");
 * you may not use this file except in compliance with the License.
 * You may obtain a copy of the License at
 *
 *     http://www.apache.org/licenses/LICENSE-2.0
 *
 * Unless required by applicable law or agreed to in writing, software
 * distributed under the License is distributed on an "AS IS" BASIS,
 * WITHOUT WARRANTIES OR CONDITIONS OF ANY KIND, either express or implied.
 * See the License for the specific language governing permissions and
 * limitations under the License.
 */

#include <stdio.h>
#include <stdlib.h>
#include <stdint.h>
#include <string.h>
#include "asr_rsa.h"
#include "asr_sec_hw_common.h"
#include "duet_pinmux.h"
#include "duet_uart.h"
#include "printf_uart.h"

#define INTEG_TEST_PRINT                        printf
#define UART_TX_PIN PAD2
#define UART_RX_PIN PAD3
#define UART_TEST_INDEX UART1_INDEX
#define UART_TEST UART1
#define UART_TEST_INDEX UART1_INDEX
#define UART_HW_FLOW_CONTROL_ENABLE 1
#define UART_HW_FLOW_CONTROL_DISABLE 0


void uart_recv_test(char data)
{
  //UART_SendData(data);
  UART_SendData(getUartxViaIdx(UART_TEST_INDEX), data);
}

void set_uart_config(uint8_t uart_idx, uint8_t hw_flow_control)
{
  duet_uart_dev_t uart_config_struct = {0};
  duet_uart_struct_init(&uart_config_struct);
  uart_config_struct.port = uart_idx;
  uart_config_struct.priv = uart_recv_test;
  // set user define config
  uart_config_struct.config.baud_rate = UART_BAUDRATE_115200;
  if (hw_flow_control)
    uart_config_struct.config.flow_control = FLOW_CTRL_CTS_RTS;
  else
    uart_config_struct.config.flow_control = FLOW_CTRL_DISABLED;
  duet_uart_init(&uart_config_struct);

}

void set_uart_pinmux(uint8_t uart_idx, uint8_t hw_flow_control)
{
  switch (uart_idx)
  {
    case UART0_INDEX:
      duet_pinmux_config(PAD0, PF_UART0);
      duet_pinmux_config(PAD1, PF_UART0);
      if (hw_flow_control)
      {
        duet_pinmux_config(PAD6, PF_UART0);
        duet_pinmux_config(PAD7, PF_UART0);
      }
      break;
    case UART1_INDEX:
      duet_pinmux_config(PAD2, PF_UART1);
      duet_pinmux_config(PAD3, PF_UART1);
      if (hw_flow_control)
      {
        duet_pinmux_config(PAD14, PF_UART1);
        duet_pinmux_config(PAD15, PF_UART1);
      }
      break;
    case UART2_INDEX:
      duet_pinmux_config(PAD12, PF_UART2);
      duet_pinmux_config(PAD13, PF_UART2);
      if (hw_flow_control)
      {
        duet_pinmux_config(PAD10, PF_UART2);
        duet_pinmux_config(PAD11, PF_UART2);
      }
      break;
    default:
      break;
  }
}

#define TST_MAX_PUB_EXP_SIZE_IN_BYTES               3
#define TST_MAX_MOD_SIZE_IN_BYTES                   256
#define TST_MAX_ENCDEC_DATA_IN_BYTES                256
#define TST_MAX_SIGN_VERIFY_DATA_IN_BYTES           512
#define TST_MAX_PUB_EXP_SIZE_IN_BYTES               3
#define TST_MAX_SINGLE_RSA_SIGN_BLOCK_SIZE_IN_BYTS  16
#define TST_LESS_DATA_FOR_PKCS1V15_ENCRYPT        11
#define TST_LESS_DATA_FOR_OAEP_ENCRYPT_SHA1        42
#define TST_LESS_DATA_FOR_OAEP_ENCRYPT_SHA224        58
#define TST_LESS_DATA_FOR_OAEP_ENCRYPT_SHA256        66
#define TST_LESS_DATA_FOR_OAEP_ENCRYPT_SHA384        98
#define TST_LESS_DATA_FOR_OAEP_ENCRYPT_SHA512        130
#define TST_NO_CRT                                 0
#define TST_CRT_MODE                                1
#define TST_RSA_512_KEY_SIZE_IN_BYTES               64
#define TST_RSA_1024_KEY_SIZE_IN_BYTES              128
#define TST_LESS_DATA_FOR_PKCS1V15_ENCRYPT        11
#define TST_LESS_DATA_FOR_OAEP_ENCRYPT_SHA1        42
#define TST_LESS_DATA_FOR_OAEP_ENCRYPT_SHA224        58
#define TST_LESS_DATA_FOR_OAEP_ENCRYPT_SHA256        66
#define TST_LESS_DATA_FOR_OAEP_ENCRYPT_SHA384        98
#define TST_LESS_DATA_FOR_OAEP_ENCRYPT_SHA512        130
#define RSA_ENCDEC_OEP_TESTS_NUMBER      0x2
#define RSA_SIGN_VERIFY_OEP_TESTS_NUMBER 0x1
#define MAX_TEST_DATA_SIZE               256
typedef struct rsaEncDecDataStuct{
    uint8_t                    rsaEncDec_Name[MAX_TEST_DATA_SIZE];
    uint8_t                    rsaEncDec_PrivetExponent_D[TST_MAX_PRVT_EXP_SIZE_IN_BYTES];
    uint8_t                    rsaEncDec_PublicExponent_E[TST_MAX_PUB_EXP_SIZE_IN_BYTES];
    uint8_t                    rsaEncDec_Modulus_N[TST_MAX_MOD_SIZE_IN_BYTES];
    uint8_t                    rsaEncDec_P[TST_MAX_PRVT_EXP_SIZE_IN_BYTES/2];
    uint8_t                    rsaEncDec_Q[TST_MAX_PRVT_EXP_SIZE_IN_BYTES/2];
    uint8_t                    rsaEncDec_dP[TST_MAX_PRVT_EXP_SIZE_IN_BYTES/2];
    uint8_t                    rsaEncDec_dQ[TST_MAX_PRVT_EXP_SIZE_IN_BYTES/2];
    uint8_t                    rsaEncDec_Qinv[TST_MAX_PRVT_EXP_SIZE_IN_BYTES/2];
    uint16_t                   rsaEncDec_KeySize;
    uint16_t                   rsaEncDec_DPSize;
    uint16_t                   rsaEncDec_PubExponentSize;
    uint8_t                    rsaEncDec_input_data[TST_MAX_ENCDEC_DATA_IN_BYTES];
    uint8_t                    rsaEncDec_output_data[TST_MAX_ENCDEC_DATA_IN_BYTES];
    uint8_t                    rsaEncDec_Expected_output_data[TST_MAX_ENCDEC_DATA_IN_BYTES];
} rsaEncDecDataStuct;
typedef struct rsaSignVerifyDataStuct{
    char                       rsaSignVerify_Name[MAX_TEST_DATA_SIZE];
    uint8_t                    rsaSignVerify_PrivetExponent_D[TST_MAX_PRVT_EXP_SIZE_IN_BYTES];
    uint8_t                    rsaSignVerify_PublicExponent_E[TST_MAX_PRVT_EXP_SIZE_IN_BYTES];
    uint8_t                    rsaSignVerify_Modulus_N[TST_MAX_MOD_SIZE_IN_BYTES];
    uint8_t                    rsaSignVerify_P[TST_MAX_PRVT_EXP_SIZE_IN_BYTES/2];
    uint8_t                    rsaSignVerify_Q[TST_MAX_PRVT_EXP_SIZE_IN_BYTES/2];
    uint8_t                    rsaSignVerify_dP[TST_MAX_PRVT_EXP_SIZE_IN_BYTES/2];
    uint8_t                    rsaSignVerify_dQ[TST_MAX_PRVT_EXP_SIZE_IN_BYTES/2];
    uint8_t                    rsaSignVerify_Qinv[TST_MAX_PRVT_EXP_SIZE_IN_BYTES/2];
    uint16_t                   rsaSignVerify_KeySize;
    uint16_t                   rsaSignVerify_DPSize;
    uint16_t                   rsaSignVerify_PubExponentSize;
    uint16_t                   rsaSignVerify_SaltLength;
    uint8_t                    rsaSignVerify_input_data[TST_MAX_SIGN_VERIFY_DATA_IN_BYTES];
    uint16_t                   rsaSignVerify_input_dataSize;
    uint8_t                    rsaSignVerify_output_signiture[TST_MAX_PRVT_EXP_SIZE_IN_BYTES];
    uint8_t                    rsaSignVerify_hash_SHA1[HASH_SHA1_DIGEST_SIZE_IN_BYTES];
    uint8_t                    rsaSignVerify_hash_SHA256[HASH_SHA256_DIGEST_SIZE_IN_BYTES];
    uint8_t                    rsaSignVerify_hash_SHA512[HASH_SHA512_DIGEST_SIZE_IN_BYTES];
} rsaSignVerifyDataStuct;
rsaEncDecDataStuct rsaEncDecDataVectors[] = {
    {
    {"Integration RSA encrypt/decrypt test - RSA key 512bit "},
        /*TST_PrivetExponent_D*/
        {0xa8,0xd6,0xfa,0x2b,0x47,0xde,0x8c,0x36,0x04,0x2a,0x32,0x55,0x7c,0xf5,0xde,0x2e,
         0xe3,0xc1,0x62,0x72,0x83,0x55,0x27,0x76,0x9f,0x6b,0xe0,0xfa,0x9a,0x26,0x03,0x9b,
         0x41,0x1f,0xd6,0xbc,0x3d,0x77,0xd0,0x5f,0xb0,0x71,0x00,0xf6,0x27,0xa7,0x55,0xf8,
         0xb4,0xc7,0x5a,0x31,0xeb,0xce,0x51,0x19,0x94,0x21,0xa6,0xac,0xb8,0xf5,0xbb,0x01},
        /*TST_PublicExponent_E*/
        {0x01,0x00,0x01},
        /*TST_Modulus_N*/
        {0xbb,0x3d,0xf1,0x3f,0x1d,0xcf,0xc6,0xfa,0x13,0x56,0xb3,0x95,0x53,0xcf,0xbd,0x10,
         0xf4,0x75,0xfe,0x7d,0xf6,0x89,0xa1,0x06,0x94,0x67,0xd4,0x5c,0xb7,0x89,0xbe,0xed,
         0xe2,0x49,0x51,0x6b,0xf0,0xd2,0x7c,0xef,0x67,0xbb,0xf6,0x9a,0x8b,0x67,0x51,0xe8,
         0xc0,0xbf,0x52,0xbc,0x2f,0x10,0xc1,0x85,0x77,0x18,0x60,0x52,0x67,0x94,0xd7,0x57},
        /*TST_P*/
        {0xf4,0xab,0x4e,0xda,0x43,0xf4,0xcd,0x34,0xb1,0xd8,0xf4,0xd6,0x97,0xea,0x6f,0x07,
         0xc8,0xfd,0xa6,0x28,0x33,0x4c,0xaf,0x60,0x9b,0x0c,0x48,0x79,0x0a,0xb0,0x14,0xb1},
        /*TST_Q*/
        {0xc3,0xe9,0xcd,0x5a,0xef,0xa1,0x27,0x15,0xbf,0x34,0xc0,0xca,0x41,0x79,0x39,0x19,
         0xf6,0xd2,0x12,0x14,0x14,0x29,0x8e,0x36,0x06,0xa8,0xd3,0xe5,0x90,0x2c,0x4e,0x87},
        /*TST_dP*/
        {0x40,0xa1,0x80,0x12,0xe8,0x20,0xa2,0x94,0x68,0xe6,0x86,0xc6,0xa9,0x1a,0xa4,0x79,
         0xc9,0xfe,0x37,0x06,0x27,0x86,0xfa,0x4c,0xea,0xa8,0x33,0xfc,0xc5,0x75,0xfe,0x01},
        /*TST_dQ*/
        {0x59,0x58,0x87,0x0e,0xb1,0xba,0x0c,0xd9,0x1e,0x1a,0x30,0xd2,0x0c,0x89,0xfc,0x40,
         0x9b,0x0f,0xb2,0xae,0xf5,0x82,0xfe,0x18,0x25,0x71,0x59,0x31,0x98,0x4e,0x9c,0x81},
        /*TST_Qinv*/
        {0xa5,0x61,0xd2,0x0d,0x6d,0xe7,0x20,0xa5,0xaf,0x9b,0x59,0x8c,0x98,0xa4,0x6a,0x4a,
         0xaf,0x76,0xab,0x60,0x57,0xd4,0xdc,0x71,0xb5,0x1d,0xf2,0xac,0x22,0x0a,0xb6,0xf5},
        /*TST_KeySize*/
        64*sizeof(uint8_t),
        /*TST_DPSize*/
        32*sizeof(uint8_t),
        /*TST_PubExponentSize*/
        3*sizeof(uint8_t),
        /*TST_input_data*/
        {0x41,0x1f,0xd6,0xbc,0x3d,0x77,0xd0,0x5f,0xb0,0x71,0x00,0xf6,0x27,0xa7,0x55,0xf8,
         0xb4,0xc7,0x5a,0x31,0xeb,0xce,0x51,0x19,0x94,0x21,0xa6,0xac,0xb8,0xf5,0xbb,0x01,
         0xa8,0xd6,0xfa,0x2b,0x47,0xde,0x8c,0x36,0x04,0x2a,0x32,0x55,0x7c,0xf5,0xde,0x2e,
         0xe3,0xc1,0x62,0x72,0x83,0x55,0x27,0x76,0x9f,0x6b,0xe0,0xfa,0x9a,0x26,0x03,0x9b},
        /*TST_output_data*/
        {0},
        /*TST_Expected_output_data*/
        {0x2d,0x99,0x04,0x94,0x8a,0x57,0x89,0x78,0xed,0x8a,0xdd,0xea,0x63,0xf5,0xe5,0x50,
         0xea,0xb5,0x83,0x89,0xb6,0xcc,0xa9,0x84,0x73,0x1d,0x1f,0x02,0x04,0x37,0x53,0xce,
         0xd6,0xa4,0xa8,0x96,0x20,0x00,0xdd,0xb3,0x91,0x67,0xac,0xbc,0xd4,0x3d,0x22,0x95,
         0x1f,0x2a,0x6c,0x17,0x10,0x35,0xa8,0x7e,0x10,0xab,0x53,0xeb,0xb4,0xef,0x27,0xcf}
    },
    {
        {"Integration RSA encrypt/decrypt test - RSA key 1024bit "},
        /*TST_PrivetExponent_D*/
        {0x0e,0x85,0x98,0x0c,0x64,0xed,0x94,0x26,0x69,0x65,0x35,0x7b,0x14,0x8d,0x78,0x58,
         0x1f,0xcc,0xaf,0x34,0x9d,0xbb,0x97,0x5d,0xdb,0xd4,0x54,0xbf,0xd3,0x14,0x30,0xf7,
         0xbc,0xad,0x1f,0x90,0x8f,0xf6,0xa4,0xad,0xec,0x59,0x63,0x6f,0xd0,0xb5,0x4b,0xc8,
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         0x09,0xd0,0x38,0xd3,0x95,0xe7,0x2f,0x37,0x76,0x78,0xc1,0xf9,0xaf,0x1a,0x81,0xa1},
        /*TST_PublicExponent_E*/
        {0x01,0x00,0x01},
        /*TST_Modulus_N*/
        {0xe6,0xf1,0x8f,0xaf,0x4d,0xb6,0x24,0xa6,0x94,0x71,0xfb,0xeb,0x01,0x56,0xb6,0xdb,
         0xca,0xdf,0xf2,0x2a,0x6c,0xb9,0x6f,0xd8,0x70,0xf2,0x8e,0x44,0x32,0xb1,0x0c,0x1b,
         0xee,0xa8,0xdc,0x03,0x33,0x72,0xe6,0xc0,0x83,0xa7,0x47,0x34,0x01,0x10,0x1e,0xa6,
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         0x20,0xde,0xc3,0x62,0x64,0xcf,0xc0,0x3f,0xe7,0x97,0xa7,0x7d,0x65,0x8e,0x31,0xeb},
        /*TST_P*/
        {0xff,0x33,0xf2,0x64,0x08,0xeb,0x67,0xb4,0xf8,0xec,0xa8,0x0a,0x19,0x60,0xb3,0xaa,
         0x9b,0x3d,0x03,0x65,0x43,0x4e,0x93,0xb6,0x20,0x38,0xe5,0xc1,0x1a,0xca,0xc0,0xb0,
         0xf2,0x6d,0x78,0xbf,0x18,0x5d,0x3d,0xa6,0xd3,0x31,0xe8,0xc8,0x36,0xc7,0xf6,0xb2,
         0xfd,0x5a,0x02,0x28,0x08,0xdc,0x57,0xb6,0x44,0x5d,0x3a,0x70,0x7d,0xfa,0x49,0x91},
        /*TST_Q*/
        {0xe7,0xaa,0x37,0xa4,0x6d,0x38,0x16,0x3f,0x3d,0x76,0x61,0x48,0xce,0x8e,0xdb,0x71,
         0x2f,0x37,0xed,0x8a,0x9f,0xfd,0x47,0x4e,0xb4,0x37,0x05,0x60,0xbc,0x7a,0xd8,0xca,
         0x6a,0x2e,0xb4,0x37,0x3e,0xc9,0xea,0x12,0x49,0x40,0x37,0x24,0x36,0x4d,0xb4,0x6a,
         0x40,0xc2,0xe5,0xe4,0x26,0xf9,0xdc,0x8a,0x07,0x9a,0x10,0x76,0x81,0x50,0xa5,0xbb},
        /*TST_dP*/
        {0x4a,0x3a,0x5b,0xc8,0x48,0xe7,0xdf,0x94,0x3d,0xca,0xe7,0xdd,0x78,0x20,0x2e,0x61,
         0xf3,0x21,0x3d,0xf9,0x98,0x28,0x24,0xc2,0x96,0x80,0xb6,0x23,0x02,0x9d,0xf2,0x8a,
         0x05,0x19,0x5e,0x43,0x86,0xdc,0xa7,0xef,0xfc,0x01,0xca,0x49,0x61,0xd5,0xab,0xa5,
         0xc8,0x17,0x04,0x05,0x8c,0xfe,0x39,0xec,0xe3,0xd9,0x92,0x03,0xe2,0x40,0x88,0x61},
        /*TST_dQ*/
        {0x36,0x0b,0x6e,0xc9,0xac,0x35,0x2e,0x73,0x78,0x6a,0x3a,0x8d,0xda,0xaa,0x57,0x25,
         0x53,0x87,0xaf,0xa1,0xec,0x6b,0x11,0x0c,0x9a,0x5c,0x4f,0xa3,0xde,0xb4,0xa6,0x08,
         0xaa,0xb6,0xd4,0x92,0x22,0xd2,0xc6,0x09,0x98,0x0f,0x24,0x0e,0x0d,0xa1,0x19,0x1a,
         0xc4,0x9a,0xf3,0x38,0xc3,0xa2,0xfc,0xc1,0x32,0xbe,0xcd,0x62,0x68,0x0e,0xa1,0x6b},
        /*TST_Qinv*/
        {0x3e,0xd1,0x50,0xec,0x76,0x0d,0xc9,0x46,0x57,0x0a,0xc9,0x73,0x16,0xdd,0x38,0x03,
         0x9d,0x36,0x61,0x19,0x08,0x6d,0x07,0x99,0xe6,0x97,0xfb,0x85,0x82,0x1d,0x00,0x7e,
         0xbe,0x17,0x7c,0x87,0xa7,0xb7,0xb2,0xaa,0x40,0x22,0xa5,0x53,0x52,0xc8,0x0b,0xf1,
         0x79,0x3a,0x24,0xa7,0xc9,0xcb,0x22,0xda,0x9a,0x17,0xc1,0x78,0xdd,0x9d,0x16,0x7d},
        /*TST_KeySize*/
        128*sizeof(uint8_t),
        /*TST_DPSize*/
        64*sizeof(uint8_t),
        /*TST_PubExponentSize*/
        3*sizeof(uint8_t),
        /*TST_input_data*/
        {0x98,0x62,0xed,0xc7,0x71,0x65,0x13,0xfb,0x51,0x62,0x3e,0xa5,0xfd,0xee,0xe3,0x8f,
         0x68,0x89,0xc7,0x74,0xed,0x81,0xce,0x57,0x8f,0x12,0xe1,0x08,0x84,0xdf,0x5e,0x44,
         0x69,0xba,0x6b,0x1a,0x3d,0x5c,0xe6,0x3e,0x82,0x51,0xd1,0x9f,0x07,0x74,0x48,0x20,
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         0x4c,0x1f,0x0c,0x44,0x45,0x83,0x43,0x4b,0xe2,0xce,0x0d,0xe4,0x71,0xe5,0x56,0x9d},
        /*TST_output_data*/
        {0},
        /*TST_Expected_output_data*/
        {0x65,0x8f,0xdc,0xcc,0x47,0x1f,0x35,0x16,0xa0,0xd8,0xde,0x08,0xc1,0x02,0xd7,0x7d,
         0x90,0x24,0x3f,0xb2,0x28,0xff,0x80,0xa9,0x46,0xc0,0xc4,0x3f,0x79,0x28,0x3c,0x6c,
         0x21,0x8f,0xa7,0xbf,0x90,0x14,0x68,0xc6,0x9a,0xfb,0x54,0x78,0x5d,0xab,0x4b,0x6e,
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         0x58,0xd9,0x3b,0xe3,0x52,0x88,0xbb,0x0e,0x04,0x02,0xbd,0x7c,0xfe,0xa5,0x6f,0xf5}
    },
};
rsaSignVerifyDataStuct rsaSignVerifyDataVectors[] = {
    {
        {"Acceptance test - RSA SignVerify 512byteData/2048bit key "},
        /*TST_PrivetExponent_D*/
        {0x8f,0x19,0xde,0xd8,0x8f,0xf5,0x9c,0xba,0x8a,0xe5,0xf2,0x2d,0x24,0x26,0xa4,0x9f,
        0x09,0x9d,0x60,0x6e,0x5e,0xee,0xbd,0x6f,0xf9,0x22,0xe4,0x74,0xea,0xcc,0x00,0x8b,
        0x16,0x68,0x20,0x37,0xcc,0x07,0xa5,0xd8,0x6a,0x63,0xdf,0x85,0x2f,0xd1,0x35,0xe7,
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        0x35,0x92,0x42,0xb5,0xe2,0xf3,0x9a,0x6f,0x51,0x28,0x19,0x34,0x3b,0xef,0x95,0x29},
        /*TST_PublicExponent_E*/
        {0x01,0x00,0x01},
        /*TST_Modulus_N*/
        {0xb0,0x8a,0x9f,0x8c,0xb9,0x40,0xc6,0x8b,0x33,0x31,0xd4,0x30,0xdb,0x4d,0x5f,0x72,
        0xd0,0x5d,0xba,0xd8,0x97,0x88,0xbd,0xb5,0x58,0xc3,0xf2,0xcb,0x85,0xb2,0xb5,0xa9,
        0x97,0x16,0x22,0xfe,0xc8,0x30,0x3c,0xd5,0xde,0x5a,0xe7,0xc0,0x45,0x31,0x74,0xc3,
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        0x81,0xcb,0x21,0x6f,0xe6,0x4c,0xaa,0xd7,0x83,0x26,0xaf,0x1e,0x0d,0x69,0x66,0xeb},
        /*TST_P*/
        {0xdb,0x11,0xac,0x82,0xcc,0xce,0xcd,0xd5,0xaa,0x91,0x86,0x6c,0x2e,0x7a,0x5c,0x85,
        0xcc,0xbe,0x04,0xd5,0xd0,0x94,0x70,0x3c,0x0e,0x7b,0x0d,0x21,0xf3,0x27,0x3d,0x61,
        0x9c,0x58,0x96,0x3f,0xb4,0x20,0x85,0xe2,0x67,0xe4,0x97,0xbf,0xa0,0xa7,0xa7,0x2d,
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        0xd7,0x18,0x31,0xef,0xe6,0xe5,0xd7,0xbf,0xc2,0x78,0x93,0x12,0x81,0x97,0x8e,0x85},
        /*TST_Q*/
        {0xce,0x4d,0x98,0x66,0xf0,0x4c,0xe2,0xb8,0x12,0xf5,0x96,0x4c,0x25,0x5a,0x9d,0x75,
        0x4a,0x89,0x44,0xb9,0x70,0xad,0x16,0xd1,0xc2,0xcc,0x26,0x74,0xde,0x41,0xea,0x28,
        0x25,0x03,0xfc,0x6f,0x3e,0x2f,0xeb,0xb6,0x3d,0x91,0xff,0x6b,0xa5,0x26,0x52,0x6d,
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        0x53,0x3a,0x18,0xfe,0xe8,0x64,0xb3,0xcd,0xa9,0x94,0xa3,0xad,0xe0,0xe5,0x32,0xaf},
        /*TST_dP*/
        {0xab,0xc0,0xe1,0x95,0xf3,0x69,0x38,0x6c,0x0a,0xbc,0xe9,0xbd,0x2b,0x7b,0x77,0xca,
        0xd7,0x49,0x2b,0x95,0x4f,0x60,0xf1,0xd5,0xc4,0x2c,0xa9,0x91,0x32,0x88,0x53,0x51,
        0x92,0x38,0xca,0x23,0xcb,0xdf,0xab,0xd8,0x64,0x48,0x0e,0xc9,0x88,0xf5,0xa8,0xd6,
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        0xf2,0x6d,0xdf,0xc9,0x0d,0x28,0xaa,0xcc,0x87,0x75,0xed,0x29,0x17,0x3d,0x71,0xd9},
        /*TST_dQ*/
        {0xa9,0x2a,0x11,0x7c,0xdf,0x30,0x7c,0x7b,0xe9,0xf7,0xfd,0x2d,0x25,0x38,0x1f,0x83,
        0x2d,0x02,0x50,0x1b,0x2b,0x1c,0x93,0x68,0x9f,0x2d,0xdd,0x9e,0xd9,0x1c,0xfd,0x8f,
        0xbb,0x82,0x80,0x3d,0x0b,0xa6,0x29,0xc6,0xfe,0xc7,0xb7,0xc4,0xa1,0xe0,0x41,0x98,
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        0x29,0xe7,0xaa,0xd5,0x62,0xe4,0x28,0x57,0xcc,0xe5,0x38,0x2d,0xfd,0x0a,0x93,0xbb},
        /*TST_Qinv*/
        {0x78,0xe0,0x41,0x17,0x2c,0xc8,0x50,0x51,0x7b,0x2b,0x44,0x8c,0xff,0x55,0x31,0xc7,
        0x31,0xa6,0xca,0x58,0x79,0x25,0x33,0x91,0x91,0x1b,0xf2,0xc6,0xf9,0x8b,0xdb,0x8e,
        0xc6,0x94,0x96,0x7b,0xd0,0x14,0xc3,0xb6,0x59,0x57,0x04,0xf6,0x31,0x3b,0x92,0x04,
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        0x1d,0x47,0xdc,0xc2,0xa9,0x2a,0xa0,0x08,0xdc,0x4a,0xe5,0xc7,0x57,0x63,0x0a,0xc3},
        /*TST_KeySize*/
        256*sizeof(uint8_t),
        /*TST_DPSize*/
        128*sizeof(uint8_t),
        /*TST_PubExponentSize*/
        3*sizeof(uint8_t),
        /*TST_SaltLength*/
        20,
        /*TST_input_data*/
        {0xa3,0x03,0x83,0xc4,0x7c,0xd2,0xff,0x38,0x34,0xcf,0xbe,0xb1,0xc6,0xdb,0x6e,0x14,
         0x9e,0xdf,0xbb,0xd7,0xc5,0xdf,0x8d,0x69,0x7a,0x07,0x75,0xbc,0xde,0x37,0x0c,0x75,
         0x5c,0x71,0xdf,0x18,0x42,0x78,0x95,0x50,0xd2,0x42,0x91,0x47,0xb9,0x59,0xb1,0x75,
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         0xc9,0xd6,0x16,0x3b,0x37,0xcf,0x63,0x19,0xb9,0xd4,0xe5,0xa7,0x92,0xa5,0x69,0x49},
        /*TST_input_dataSize*/
        512*sizeof(uint8_t),
        /*TST_output_signiture*/
        {0},
        /*TST_input_hash_SHA1*/
        {0x41,0x1f,0xd6,0xbc,0x3d,0x77,0xd0,0x5f,0xb0,0x71,0x00,0xf6,0x27,0xa7,0x55,0xf8,
        0x41,0x1f,0xd6,0xbc},
        /*TST_input_hash_SHA256*/
        {0x53,0xca,0xe2,0x11,0x6d,0x21,0x1e,0x0e,0x79,0x91,0xf7,0x57,0xbe,0x44,0x4b,0x4e,
        0x59,0xbd,0x78,0x8d,0xc5,0xfc,0xaf,0xf7,0xfb,0x46,0xaa,0x0a,0x4c,0xb1,0x7d,0x98},
        /*TST_input_hash_SHA512*/
        {0xd2,0xf5,0x71,0xe2,0x8d,0x37,0x5c,0xdd,0xe4,0x65,0xa7,0x24,0xc3,0xfa,0xc7,0x5a,
        0x41,0x7d,0xaa,0xed,0xcc,0x53,0x8a,0x31,0x36,0x00,0x51,0x1d,0xa5,0xa2,0x39,0xcc,
        0x4b,0x1d,0x93,0x8e,0x0a,0x50,0x95,0x10,0x7e,0x63,0x63,0x9e,0x2b,0xce,0x93,0xdf,
        0xca,0x33,0xc1,0x6b,0x8f,0xf0,0x4b,0x5c,0x11,0xaf,0x66,0x96,0x9d,0x43,0xf1,0x5e},
        }
};
int rsa_SignVerify_tests(void){

    int                             ret = 0;
    int                             test_index;
    RSAType_enum                    RSA_mode;
    RSAUserPrivKey_t                UserPrivKey;
    RSAUserPubKey_t                 UserPubKey;
    RSAKGData_t                     KeyGenData;
    RSAKGFipsContext_t              FipsCtx;
    RSAPrivUserContext_t            ContextPrivate;
    RSAPubUserContext_t             ContextPub;
    uint16_t                        ActualSignatureSize;

    /*Run all RSA tests*/
    for (RSA_mode = NON_CRT_MODE ; RSA_mode <= CRT_MODE; RSA_mode++) /* Check both CRT and non CRT modes*/
    {
        for (test_index = 0; test_index < RSA_SIGN_VERIFY_OEP_TESTS_NUMBER ; test_index++) /*Run with all RSA data vectors*/
        {
            if (test_index == 0){ /*Check internal keys*/
                if (RSA_mode == NON_CRT_MODE ){ /*Check non CRT keys*/
                    ret = asr_rsa_keypair_gen(rndContext_ptr,
                        rsaSignVerifyDataVectors[test_index].rsaSignVerify_PublicExponent_E,
                        rsaSignVerifyDataVectors[test_index].rsaSignVerify_PubExponentSize,
                        rsaSignVerifyDataVectors[test_index].rsaSignVerify_KeySize*8,
                        &UserPrivKey,
                        &UserPubKey,
                        &KeyGenData,
                        &FipsCtx);
                    if (ret != ASR_SILIB_RET_OK){
                        INTEG_TEST_PRINT(" asr_rsa_keypair_gen in Non_CRT mode failed, ret is %#x \r\n", ret);
                        goto endRSA;
                    }
                } else {/*Check CRT keys*/
                    ret = asr_rsa_keypair_crt_gen(rndContext_ptr,
                        rsaSignVerifyDataVectors[test_index].rsaSignVerify_PublicExponent_E,
                        rsaSignVerifyDataVectors[test_index].rsaSignVerify_PubExponentSize,
                        rsaSignVerifyDataVectors[test_index].rsaSignVerify_KeySize*8,
                        &UserPrivKey,
                        &UserPubKey,
                        &KeyGenData,
                        &FipsCtx);
                    if (ret != ASR_SILIB_RET_OK){
                        INTEG_TEST_PRINT(" asr_rsa_keypair_gen in Non_CRT mode failed, ret is %#x \r\n", ret);
                        goto endRSA;
                    }
                }

            } else { /*Check external keys*/
                ret = asr_rsa_build_pubkey(&UserPubKey,
                    rsaSignVerifyDataVectors[test_index].rsaSignVerify_PublicExponent_E,
                    rsaSignVerifyDataVectors[test_index].rsaSignVerify_PubExponentSize,
                    rsaSignVerifyDataVectors[test_index].rsaSignVerify_Modulus_N,
                    rsaSignVerifyDataVectors[test_index].rsaSignVerify_KeySize);

                    if (ret != ASR_SILIB_RET_OK){
                        INTEG_TEST_PRINT(" asr_rsa_build_pubkey failed, ret is %#x \r\n", ret);
                        goto endRSA;
                    }
                    if (RSA_mode == NON_CRT_MODE) {/*Check non CRT keys*/
                        ret = asr_rsa_build_prikey (&UserPrivKey,
                            rsaSignVerifyDataVectors[test_index].rsaSignVerify_PrivetExponent_D,
                            rsaSignVerifyDataVectors[test_index].rsaSignVerify_KeySize,
                            rsaSignVerifyDataVectors[test_index].rsaSignVerify_PublicExponent_E,
                            rsaSignVerifyDataVectors[test_index].rsaSignVerify_PubExponentSize,
                            rsaSignVerifyDataVectors[test_index].rsaSignVerify_Modulus_N,
                            rsaSignVerifyDataVectors[test_index].rsaSignVerify_KeySize);

                        if (ret != ASR_SILIB_RET_OK){
                            INTEG_TEST_PRINT(" asr_rsa_build_prikey in Non_CRT mode failed, ret is %#x \r\n", ret);
                            goto endRSA;
                        }
                } else { /*Check CRT keys*/

                    ret = asr_rsa_build_prikey_crt (&UserPrivKey,
                        rsaSignVerifyDataVectors[test_index].rsaSignVerify_P,
                        rsaSignVerifyDataVectors[test_index].rsaSignVerify_DPSize,
                        rsaSignVerifyDataVectors[test_index].rsaSignVerify_Q,
                        rsaSignVerifyDataVectors[test_index].rsaSignVerify_DPSize,
                        rsaSignVerifyDataVectors[test_index].rsaSignVerify_dP,
                        rsaSignVerifyDataVectors[test_index].rsaSignVerify_DPSize,
                        rsaSignVerifyDataVectors[test_index].rsaSignVerify_dQ,
                        rsaSignVerifyDataVectors[test_index].rsaSignVerify_DPSize,
                        rsaSignVerifyDataVectors[test_index].rsaSignVerify_Qinv,
                        rsaSignVerifyDataVectors[test_index].rsaSignVerify_DPSize);
                    if (ret != ASR_SILIB_RET_OK){
                        INTEG_TEST_PRINT(" asr_rsa_build_prikey_crt in CRT mode failed, ret is %#x \r\n", ret);
                        goto endRSA;
                    }
                }

            }
            ActualSignatureSize = rsaSignVerifyDataVectors[test_index].rsaSignVerify_KeySize;
            ret = asr_rsa_pss_sign(rndContext_ptr,
                &ContextPrivate,
                &UserPrivKey,
                RSA_HASH_SHA512_mode,
                PKCS1_MGF1,
                rsaSignVerifyDataVectors[test_index].rsaSignVerify_SaltLength,
                rsaSignVerifyDataVectors[test_index].rsaSignVerify_input_data,//DataIn_ptr,
                rsaSignVerifyDataVectors[test_index].rsaSignVerify_input_dataSize,//DataInSize,
                rsaSignVerifyDataVectors[test_index].rsaSignVerify_output_signiture,//Output_ptr,
                &ActualSignatureSize);

            if (ret != ASR_SILIB_RET_OK){
                INTEG_TEST_PRINT(" asr_rsa_pss_sign failed, ret is %#x \r\n", ret);
                goto endRSA;
            }
            /*Verify the signature using using SHA512*/
            ret = asr_rsa_pss_verify(
                &ContextPub,
                &UserPubKey,
                RSA_HASH_SHA512_mode,
                PKCS1_MGF1,
                rsaSignVerifyDataVectors[test_index].rsaSignVerify_SaltLength,
                rsaSignVerifyDataVectors[test_index].rsaSignVerify_input_data,
                rsaSignVerifyDataVectors[test_index].rsaSignVerify_input_dataSize,
                rsaSignVerifyDataVectors[test_index].rsaSignVerify_output_signiture);

            if (ret != ASR_SILIB_RET_OK){
                INTEG_TEST_PRINT(" asr_rsa_pss_verify failed, ret is %#x \r\n", ret);
                goto endRSA;
            }

            ActualSignatureSize = rsaSignVerifyDataVectors[test_index].rsaSignVerify_KeySize;

            /*Call CRYS_RSA_PKCS1v15_Sign PKCS#1 ver1.5 to sign on input data*/
            ret = asr_rsa_pkcs1v15_sign(rndContext_ptr,
                &ContextPrivate,
                &UserPrivKey,
                RSA_HASH_SHA256_mode,
                rsaSignVerifyDataVectors[test_index].rsaSignVerify_input_data,
                rsaSignVerifyDataVectors[test_index].rsaSignVerify_input_dataSize,
                rsaSignVerifyDataVectors[test_index].rsaSignVerify_output_signiture,
                &ActualSignatureSize);

            if (ret != ASR_SILIB_RET_OK){
                INTEG_TEST_PRINT(" asr_rsa_pkcs1v15_sign failed, ret is %#x \r\n", ret);
                goto endRSA;
            }
            /*Verify the signature*/
            ret = asr_rsa_pkcs1v15_verify(&ContextPub,
                &UserPubKey,
                RSA_HASH_SHA256_mode,
                rsaSignVerifyDataVectors[test_index].rsaSignVerify_input_data,
                rsaSignVerifyDataVectors[test_index].rsaSignVerify_input_dataSize,
                rsaSignVerifyDataVectors[test_index].rsaSignVerify_output_signiture);

            if (ret != ASR_SILIB_RET_OK){
                INTEG_TEST_PRINT(" asr_rsa_pkcs1v15_verify failed, ret is %#x \r\n", ret);
                goto endRSA;
            }

            ActualSignatureSize = rsaSignVerifyDataVectors[test_index].rsaSignVerify_KeySize;
            INTEG_TEST_PRINT(" Passed \r\n");
        }
    }

endRSA:
    return ret;
}
int rsa_EncDec_tests(void){
    int                             ret = 0;
    int                             test_index;
    uint16_t                        ActualDecDataSize;
    RSAType_enum                    RSA_mode;
    RSAUserPrivKey_t                UserPrivKey;
    RSAUserPubKey_t                 UserPubKey;
    RSAKGData_t                     KeyGenData;
    RSAKGFipsContext_t              FipsCtx;
    RSAPrimeData_t                  PrimeData;
    RSA_HASH_OpMode_t               HASH_OpMode;
    uint16_t                        LessData_for_OAEP;

    /*Run all RSA tests*/
    for (RSA_mode = NON_CRT_MODE ; RSA_mode <= CRT_MODE; RSA_mode++) /* Check both CRT and non CRT modes*/
    {
        for (test_index = 0; test_index < RSA_ENCDEC_OEP_TESTS_NUMBER ; test_index++) /*Run with all RSA data vectors*/
        {
            if (test_index == 0){ /*Check different hash modes*/
                HASH_OpMode = RSA_HASH_SHA1_mode;
                LessData_for_OAEP = TST_LESS_DATA_FOR_OAEP_ENCRYPT_SHA1; //Select the size according to the hash mode*/
            }else {
                HASH_OpMode = RSA_HASH_SHA256_mode;
                LessData_for_OAEP = TST_LESS_DATA_FOR_OAEP_ENCRYPT_SHA256;//Select the size according to the hash mode*/
            }
            /*Update ActualDecDataSize to output size*/
            ActualDecDataSize = rsaEncDecDataVectors[test_index].rsaEncDec_KeySize*8;
            INTEG_TEST_PRINT(" Test Parameters : %s \r\n",rsaEncDecDataVectors[test_index].rsaEncDec_Name);

            if (test_index == 0){ /*Check internal keys*/
                if (RSA_mode == NON_CRT_MODE ){ /*Check non CRT keys*/
                    ret = asr_rsa_keypair_gen(rndContext_ptr,
                        rsaEncDecDataVectors[test_index].rsaEncDec_PublicExponent_E,
                        rsaEncDecDataVectors[test_index].rsaEncDec_PubExponentSize,
                        rsaEncDecDataVectors[test_index].rsaEncDec_KeySize*8,
                        &UserPrivKey,
                        &UserPubKey,
                        &KeyGenData,
                        &FipsCtx);
                    if (ret != ASR_SILIB_RET_OK){
                        INTEG_TEST_PRINT(" asr_rsa_keypair_gen failed, ret is %#x \r\n", ret);
                        goto endRSA;
                    }
                } else {/*Check CRT keys*/
                    ret = asr_rsa_keypair_crt_gen(rndContext_ptr,
                        rsaEncDecDataVectors[test_index].rsaEncDec_PublicExponent_E,
                        rsaEncDecDataVectors[test_index].rsaEncDec_PubExponentSize,
                        rsaEncDecDataVectors[test_index].rsaEncDec_KeySize*8,
                        &UserPrivKey,
                        &UserPubKey,
                        &KeyGenData,
                        &FipsCtx);
                    if (ret != ASR_SILIB_RET_OK){
                        INTEG_TEST_PRINT(" asr_rsa_keypair_crt_gen failed, ret is %#x \r\n", ret);
                        goto endRSA;
                    }
                }

            } else { /*Check external keys*/
                ret = asr_rsa_build_pubkey(&UserPubKey,
                    rsaEncDecDataVectors[test_index].rsaEncDec_PublicExponent_E,
                    rsaEncDecDataVectors[test_index].rsaEncDec_PubExponentSize,
                    rsaEncDecDataVectors[test_index].rsaEncDec_Modulus_N,
                    rsaEncDecDataVectors[test_index].rsaEncDec_KeySize);

                    if (ret != ASR_SILIB_RET_OK){
                        INTEG_TEST_PRINT(" asr_rsa_build_pubkey failed, ret is %#x \r\n", ret);
                        goto endRSA;
                    }
                    if (RSA_mode == NON_CRT_MODE) {/*Check non CRT keys*/
                        ret =  asr_rsa_build_prikey (&UserPrivKey,
                            rsaEncDecDataVectors[test_index].rsaEncDec_PrivetExponent_D,
                            rsaEncDecDataVectors[test_index].rsaEncDec_KeySize,
                            rsaEncDecDataVectors[test_index].rsaEncDec_PublicExponent_E,
                            rsaEncDecDataVectors[test_index].rsaEncDec_PubExponentSize,
                            rsaEncDecDataVectors[test_index].rsaEncDec_Modulus_N,
                            rsaEncDecDataVectors[test_index].rsaEncDec_KeySize);

                        if (ret != ASR_SILIB_RET_OK){
                            INTEG_TEST_PRINT(" asr_rsa_build_prikey failed, ret is %#x \r\n", ret);
                            goto endRSA;
                        }
                } else { /*Check CRT keys*/
                    ret =  asr_rsa_build_prikey_crt (&UserPrivKey,
                        rsaEncDecDataVectors[test_index].rsaEncDec_P,
                        rsaEncDecDataVectors[test_index].rsaEncDec_DPSize,
                        rsaEncDecDataVectors[test_index].rsaEncDec_Q,
                        rsaEncDecDataVectors[test_index].rsaEncDec_DPSize,
                        rsaEncDecDataVectors[test_index].rsaEncDec_dP,
                        rsaEncDecDataVectors[test_index].rsaEncDec_DPSize,
                        rsaEncDecDataVectors[test_index].rsaEncDec_dQ,
                        rsaEncDecDataVectors[test_index].rsaEncDec_DPSize,
                        rsaEncDecDataVectors[test_index].rsaEncDec_Qinv,
                        rsaEncDecDataVectors[test_index].rsaEncDec_DPSize);

                    if (ret != ASR_SILIB_RET_OK){
                        INTEG_TEST_PRINT(" asr_rsa_build_prikey_crt failed, ret is %#x \r\n", ret);
                        goto endRSA;
                    }
                }
            }
            ret =  asr_rsa_oaep_encrypt(rndContext_ptr,
                &UserPubKey,
                &PrimeData,
                HASH_OpMode,
                NULL,
                0,
                PKCS1_MGF1,
                rsaEncDecDataVectors[test_index].rsaEncDec_input_data,
                (uint16_t)(rsaEncDecDataVectors[test_index].rsaEncDec_KeySize-LessData_for_OAEP),
                    rsaEncDecDataVectors[test_index].rsaEncDec_output_data);

            if (ret != ASR_SILIB_RET_OK){
                    INTEG_TEST_PRINT(" asr_rsa_oaep_encrypt failed, ret is %#x \r\n", ret);
                    goto endRSA;
                }
            ret = asr_rsa_oaep_decrypt(&UserPrivKey,
                &PrimeData,
                HASH_OpMode,
                NULL,
                0,
                PKCS1_MGF1,
                rsaEncDecDataVectors[test_index].rsaEncDec_output_data,
                (uint16_t)rsaEncDecDataVectors[test_index].rsaEncDec_KeySize,
                rsaEncDecDataVectors[test_index].rsaEncDec_output_data,//Inplace operation
                &ActualDecDataSize);

                if (ret != ASR_SILIB_RET_OK){
                    INTEG_TEST_PRINT(" asr_rsa_oaep_decrypt failed, ret is %#x \r\n", ret);
                    goto endRSA;
                }
            /*Compare decrypted buffer with input buffer*/
            ret = memcmp(rsaEncDecDataVectors[test_index].rsaEncDec_output_data ,
                rsaEncDecDataVectors[test_index].rsaEncDec_input_data,
                rsaEncDecDataVectors[test_index].rsaEncDec_KeySize-LessData_for_OAEP);

            if (ret != 0){
                INTEG_TEST_PRINT(" OAEP Decrypt data Failed, ret is %#x \r\n", ret);
                goto endRSA;
            }
            INTEG_TEST_PRINT(" OAEP Decrypt data Passed \r\n");

            /*Update ActualDecDataSize to output size*/
            ActualDecDataSize = rsaEncDecDataVectors[test_index].rsaEncDec_KeySize*8;
            ret = asr_rsa_pkcs1v15_encrypt(rndContext_ptr,
                &UserPubKey,
                &PrimeData,
                rsaEncDecDataVectors[test_index].rsaEncDec_input_data,
                (uint16_t)(rsaEncDecDataVectors[test_index].rsaEncDec_KeySize-TST_LESS_DATA_FOR_PKCS1V15_ENCRYPT),
                rsaEncDecDataVectors[test_index].rsaEncDec_output_data);
            if (ret != ASR_SILIB_RET_OK){
                INTEG_TEST_PRINT(" asr_rsa_pkcs1v15_encrypt Failed, ret is %#x \r\n", ret);
                goto endRSA;
            }
            /*DEcrypt oupu buffer*/
            ret = asr_rsa_pkcs1v15_decrypt(&UserPrivKey,
                &PrimeData,
                rsaEncDecDataVectors[test_index].rsaEncDec_output_data,
                rsaEncDecDataVectors[test_index].rsaEncDec_KeySize,
                rsaEncDecDataVectors[test_index].rsaEncDec_output_data,//Inplace operation
                &ActualDecDataSize);

            if (ret != ASR_SILIB_RET_OK){
                INTEG_TEST_PRINT(" asr_rsa_pkcs1v15_decrypt Failed, ret is %#x \r\n", ret);
                goto endRSA;
            }

            /*Compare decrypted buffer with input buffer*/
            ret = memcmp(rsaEncDecDataVectors[test_index].rsaEncDec_output_data ,
                rsaEncDecDataVectors[test_index].rsaEncDec_input_data,
                rsaEncDecDataVectors[test_index].rsaEncDec_KeySize-LessData_for_OAEP);

            if (ret != 0){
                INTEG_TEST_PRINT(" PKCS1V15 Decrypt data Failed, ret is %#x \r\n", ret);
                goto endRSA;
            }
            INTEG_TEST_PRINT(" PKCS1V15 Decrypt data Passed \r\n");
        }
    }

endRSA:
    return ret;
}
int rsa_tests(void){
    int ret = 0;

    INTEG_TEST_PRINT(" ----rsa_EncDec_tests start---- \r\n");

    ret = rsa_EncDec_tests();
    if (ret != ASR_SILIB_RET_OK) {
        return ret;
    }

    INTEG_TEST_PRINT(" ----rsa_EncDec_tests end---- \r\n");
    INTEG_TEST_PRINT(" ----rsa_SignVerify_tests start---- \r\n");

    /*Call to RSA Sign/Verify Tests*/
    ret = rsa_SignVerify_tests();
    if (ret != ASR_SILIB_RET_OK) {
        return ret;
    }

    INTEG_TEST_PRINT(" ----rsa_SignVerify_tests end---- \r\n");

    return ret;
}
int rsa_self_test()
{
    int ret = 0;

    /*Call ecc test*/
    ret = rsa_tests();
    if (ret != ASR_SILIB_RET_OK) {
        return ret;
    }

    return 0;
}

int main(void)
{
    uint8_t uart_idx        = UART_TEST_INDEX;
    uint8_t hw_flow_control = UART_HW_FLOW_CONTROL_DISABLE;
    // set pin mux
    set_uart_pinmux(uart_idx, hw_flow_control);
    set_uart_config(uart_idx, hw_flow_control);
    printf_uart_register(uart_idx);
    asr_security_engine_init();
    rsa_self_test();
    asr_security_engine_deinit();
    while(1);
}
/*
void * _sbrk(int nbytes)
{
    //variables from linker script
    extern char _end[];
    extern char _estack[];
    extern char _Min_Stack_Size[];

    static char *heap_ptr = _end;

    if((unsigned int)(_estack - (heap_ptr+nbytes)) > (unsigned int)_Min_Stack_Size)
    {
        void *base = heap_ptr;
        heap_ptr += nbytes;
        return base;
    }
    else
    {
        return (void *)(-1);
    }
}
*/